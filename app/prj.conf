## CMakeLists.txt
```
#-------------------------------------------------------------------------------
# Zephyr Example Application
#
# Copyright (c) 2021 Nordic Semiconductor ASA
# SPDX-License-Identifier: Apache-2.0

cmake_minimum_required(VERSION 3.13.1)
find_package(Zephyr REQUIRED HINTS $ENV{ZEPHYR_BASE})

project(app LANGUAGES C)

target_sources(app PRIVATE src/main.c src/adc.c src/modbus_cb.c src/onewire.c src/pwm.c)
```

## prj.conf
```kconfig
# Copyright (c) 2021 Nordic Semiconductor ASA
# SPDX-License-Identifier: Apache-2.0
#
# This file contains selected Kconfig options for the application.

CONFIG_SENSOR=y
#CONFIG_BLINK=y

CONFIG_GPIO=y
CONFIG_SERIAL=y
CONFIG_UART_INTERRUPT_DRIVEN=y
CONFIG_UART_LINE_CTRL=n

CONFIG_MODBUS=y
CONFIG_MODBUS_ROLE_SERVER=y
CONFIG_MODBUS_LOG_LEVEL_DBG=n

CONFIG_SHELL=y
CONFIG_SHELL_BACKEND_SERIAL=y
CONFIG_SHELL_BACKEND_SERIAL_INTERRUPT_DRIVEN=y
#CONFIG_GPIO_SHELL=y
CONFIG_W1_SHELL=y
#CONFIG_SENSOR_SHELL=y
#CONFIG_I2C_SHELL=y
#CONFIG_ADC_SHELL=y

CONFIG_LOG=y
CONFIG_LOG_CMDS=y
CONFIG_SHELL_LOG_BACKEND=y

CONFIG_PWM=y

CONFIG_ADC=y
CONFIG_DMA=y
CONFIG_ADC_STM32_DMA=y
CONFIG_ADC_ASYNC=y

CONFIG_W1=y
```

## src/main.c
```c
/*
 * Copyright (c) 2020 PHYTEC Messtechnik GmbH
 * Copyright (c) 2022 Nordic Semiconductor ASA
 *
 * SPDX-License-Identifier: Apache-2.0
 */

#include <zephyr/kernel.h>
#include <zephyr/sys/util.h>
#include <zephyr/drivers/gpio.h>
#include <zephyr/modbus/modbus.h>
#include <zephyr/drivers/pwm.h>
#include <zephyr/drivers/sensor.h>

#include "modbus_cb.h"
#include "config.h"
#include "adc.h"
#include "onewire.h"
#include "pwm.h"

#include <zephyr/logging/log.h>
LOG_MODULE_REGISTER(main, LOG_LEVEL_DBG);

static const struct gpio_dt_spec led_dev[] = {
	GPIO_DT_SPEC_GET(DT_ALIAS(led1), gpios),
	GPIO_DT_SPEC_GET(DT_ALIAS(led2), gpios),
};

uint8_t coils_state;


const static struct modbus_iface_param server_param = {
	.mode = MODBUS_MODE_RTU,
	.server = {
		.user_cb = &mbs_cbs,
		.unit_id = MODBUS_ADDR,
	},
	.serial = {
		.baud = 115200,
		.parity = UART_CFG_PARITY_NONE,
	},
};

#define MODBUS_NODE DT_COMPAT_GET_ANY_STATUS_OKAY(zephyr_modbus_serial)

static int init_modbus_server(void)
{
	const char iface_name[] = {DEVICE_DT_NAME(MODBUS_NODE)};
	int iface;

	iface = modbus_iface_get_by_name(iface_name);

	if (iface < 0) {
		LOG_ERR("Failed to get iface index for %s", iface_name);
		return iface;
	}

	return modbus_init_server(iface, server_param);
}

int main(void)
{
	int err;

	for (int i = 0; i < ARRAY_SIZE(led_dev); i++) {
		if (!gpio_is_ready_dt(&led_dev[i])) {
			LOG_ERR("LED%u GPIO device not ready", i);
			return 0;
		}

		err = gpio_pin_configure_dt(&led_dev[i], GPIO_OUTPUT_INACTIVE);
		if (err != 0) {
			LOG_ERR("Failed to configure LED%u pin", i);
			return 0;
		}
	}


	int ret;
	if (init_pwm()){
		LOG_ERR("PWM initialization failed");
	}


	if (init_modbus_server()) {
		LOG_ERR("Modbus RTU server initialization failed");
	}

	if (init_adc()){
		LOG_ERR("ADC initialization failed");
	}

	while (true){
		LOG_INF("Waiting...");
		int rc;
		rc = print_die_temperature();
		if (rc < 0) {
			return 0;
		}
		rc = print_vref_voltage();
		if (rc < 0) {
			return 0;
		}
		read_adc();

		rescan_onewire();
		trigger_sensors(collected_sensors_onewire, num_collected_sensors_onewire);
		k_msleep(1000);
	}
	return 0;
}
```

## src/adc.c
```c
#include <zephyr/drivers/adc.h>
#include <zephyr/drivers/sensor.h>

#include <zephyr/logging/log.h>
LOG_MODULE_REGISTER(adc, LOG_LEVEL_DBG);

uint16_t adc_vin_v;
uint16_t adc_12v_v;
uint16_t adc_vin_i;
uint16_t adc_3v3_v;
uint16_t adc_temp_int;

/* ADC node from the devicetree. */
#define ADC_NODE DT_ALIAS(adc0)

/* Auxiliary macro to obtain channel vref, if available. */
#define CHANNEL_VREF(node_id) DT_PROP_OR(node_id, zephyr_vref_mv, 0)

/* Data of ADC device specified in devicetree. */
static const struct device *adc = DEVICE_DT_GET(ADC_NODE);

/* Data array of ADC channels for the specified ADC. */
static const struct adc_channel_cfg channel_cfgs[] = {
	DT_FOREACH_CHILD_SEP(ADC_NODE, ADC_CHANNEL_CFG_DT, (,))};

/* Data array of ADC channel voltage references. */
static uint32_t vrefs_mv[] = {DT_FOREACH_CHILD_SEP(ADC_NODE, CHANNEL_VREF, (,))};

/* Get the number of channels defined on the DTS. */
#define CHANNEL_COUNT ARRAY_SIZE(channel_cfgs)

static uint32_t count = 0;

static const struct device * die_temp = DEVICE_DT_GET(DT_ALIAS(die_temp0));
static const struct device * vref_voltage = DEVICE_DT_GET(DT_ALIAS(volt_sensor0));

static struct adc_sequence adc_sequence;
static struct adc_sequence_options options; 
static uint16_t channel_reading[CONFIG_SEQUENCE_SAMPLES][CHANNEL_COUNT];

int init_adc(void){
	int rc;

	if (!device_is_ready(die_temp)) {
		LOG_ERR("sensor: device %s not ready.\n", die_temp->name);
		return -2;
	}
	if (!device_is_ready(vref_voltage)) {
		LOG_ERR("sensor: device %s not ready.\n", vref_voltage->name);
		return -2;
	}

	int err;
	LOG_DBG("Samples: %d, channels: %d",CONFIG_SEQUENCE_SAMPLES, CHANNEL_COUNT);

	/* Options for the sequence sampling. */
	options.extra_samplings = CONFIG_SEQUENCE_SAMPLES - 1;
	options.interval_us = 0;

	/* Configure the sampling sequence to be made. */
	adc_sequence.buffer = channel_reading;
		/* buffer size in bytes, not number of samples */
	adc_sequence.buffer_size = sizeof(channel_reading);
	adc_sequence.resolution = CONFIG_SEQUENCE_RESOLUTION;
	adc_sequence.oversampling = CONFIG_SEQUENCE_OVERSAMPLING;
	adc_sequence.options = &options;

	if (!device_is_ready(adc)) {
		printf("ADC controller device %s not ready\n", adc->name);
		return -1;
	}

	/* Configure channels individually prior to sampling. */
	for (size_t i = 0U; i < CHANNEL_COUNT; i++) {
		adc_sequence.channels |= BIT(channel_cfgs[i].channel_id);
		err = adc_channel_setup(adc, &channel_cfgs[i]);
		if (err < 0) {
			LOG_ERR("Could not setup channel #%d (%d)\n", i, err);
			return -1;
		}
		if ((vrefs_mv[i] == 0) && (channel_cfgs[i].reference == ADC_REF_INTERNAL)) {
			vrefs_mv[i] = adc_ref_internal(adc);
		}
	}

	LOG_DBG("Successfully initialized");

	return 0;
}

int read_adc(void){
	int err;
	LOG_DBG("ADC sequence reading [%u]:\n", count++);

	err = adc_read(adc, &adc_sequence);
	if (err < 0) {
		LOG_ERR("Could not read (%d)\n", err);
		return 1;
	}

	for (size_t channel_index = 0U; channel_index < CHANNEL_COUNT; channel_index++) {
		int32_t val_mv;

		printf("- %s, channel %" PRId32 ", %" PRId32 " sequence samples:\n",
		       adc->name, channel_cfgs[channel_index].channel_id,
		       CONFIG_SEQUENCE_SAMPLES);
		for (size_t sample_index = 0U; sample_index < CONFIG_SEQUENCE_SAMPLES;
		     sample_index++) {
			uint8_t res = CONFIG_SEQUENCE_RESOLUTION;

			val_mv = channel_reading[sample_index][channel_index];
			printf("- - %" PRId32, val_mv);
			err = adc_raw_to_millivolts(vrefs_mv[channel_index],
						    channel_cfgs[channel_index].gain,
						    res, &val_mv);

			/* conversion to mV may not be supported, skip if not */
			if ((err < 0) || vrefs_mv[channel_index] == 0) {
				printf(" (value in mV not available)\n");
			} else {
				printf(" = %" PRId32 "mV\n", val_mv);
			}
		}
	}
	// TODO move resistor values to the board config
	int32_t val_mv;
	val_mv = channel_reading[0][0];
	adc_raw_to_millivolts(vrefs_mv[0],channel_cfgs[0].gain,CONFIG_SEQUENCE_RESOLUTION,&val_mv);
	adc_vin_v = val_mv*(24000+1500)/1500;

	val_mv = channel_reading[0][1];
	adc_raw_to_millivolts(vrefs_mv[1],channel_cfgs[1].gain,CONFIG_SEQUENCE_RESOLUTION,&val_mv);
	adc_12v_v = val_mv*(24000+1500)/1500;

	val_mv = channel_reading[0][2];
	k_msleep(100);
	adc_raw_to_millivolts(vrefs_mv[2],channel_cfgs[2].gain,CONFIG_SEQUENCE_RESOLUTION,&val_mv);
	// 50V/V, 6mohm
	//(val_mv/50/1000 / 6/1000)*1000
	//(val_mv/50 / 6)*1000
	//(val_mv*20 / 6)
	adc_vin_i = val_mv*20/6;
	
	LOG_DBG("Vin: %u mV, 12V: %u mV, Iin: %u mA",adc_vin_v, adc_12v_v, adc_vin_i);


	return 0;
}

// Die temp

int print_die_temperature(void)
{
	const struct device *dev = die_temp;
	struct sensor_value val;
	int rc;

	/* fetch sensor samples */
	rc = sensor_sample_fetch(dev);
	if (rc) {
		printk("Failed to fetch sample (%d)\n", rc);
		return rc;
	}

	rc = sensor_channel_get(dev, SENSOR_CHAN_DIE_TEMP, &val);
	if (rc) {
		printk("Failed to get data (%d)\n", rc);
		return rc;
	}

	printk("CPU Die temperature[%s]: %d °C\n", dev->name, val.val1);
	adc_temp_int = val.val1;
	return 0;
}

// Internal reference voltage

int print_vref_voltage(void)
{
	const struct device *dev = vref_voltage;
	struct sensor_value val;
	int rc;

	/* fetch sensor samples */
	rc = sensor_sample_fetch(dev);
	if (rc) {
		printk("Failed to fetch sample (%d)\n", rc);
		return rc;
	}

	rc = sensor_channel_get(dev, SENSOR_CHAN_VOLTAGE, &val);
	if (rc) {
		printk("Failed to get data (%d)\n", rc);
		return rc;
	}

	printk("VREF voltage[%s]: %d mV\n", dev->name, sensor_value_to_milli(&val));
	adc_3v3_v = sensor_value_to_milli(&val);
	return 0;
}
```

## src/adc.h
```c
#ifndef ADC_H
#define ADC_H
#include <stdint.h>

extern uint16_t adc_vin_v;
extern uint16_t adc_12v_v;
extern uint16_t adc_3v3_v;
extern uint16_t adc_vin_i;
extern uint16_t adc_temp_int;

int init_adc(void);
int read_adc(void);
int print_die_temperature(void);

#endif // ADC_H
```

## src/config.h
```c
#ifndef APP_CONFIG_H
#define APP_CONFIG_H

#define MODBUS_ADDR     1

#define MODBUS_PWM0_REG		10
#define MODBUS_PWM1_REG		11
#define MODBUS_PWM2_REG		12

#define MODBUS_BASE_STATUS_REG	1
#define MODBUS_BASE_UPTIME_REG	2
#define MODBUS_BASE_VIN_REG	5
#define MODBUS_BASE_IIN_REG	6
#define MODBUS_BASE_3V3_REG	7
#define MODBUS_BASE_TEMPINT_REG	8

#define MODBUS_TEMP0_REG		200
#define MODBUS_N_THERMOMETERS	2
#define MODBUS_TEMP_MAX_AGE	10

#endif
```

## src/modbus_cb.c
```c
#include <stdint.h>

#include <zephyr/kernel.h>
#include <zephyr/sys/util.h>
#include <zephyr/drivers/gpio.h>
#include <zephyr/modbus/modbus.h>
#include <zephyr/drivers/pwm.h>
#include <zephyr/drivers/sensor.h>

#include "config.h"
#include "adc.h"
#include "pwm.h"
#include "onewire.h"

#include <zephyr/logging/log.h>
LOG_MODULE_REGISTER(modbus_cb, LOG_LEVEL_DBG);

static const struct pwm_dt_spec pwm_o1 =
	PWM_DT_SPEC_GET(DT_ALIAS(pwmled1));
static const struct pwm_dt_spec pwm_o2 =
	PWM_DT_SPEC_GET(DT_ALIAS(pwmled2));
static const struct pwm_dt_spec pwm_o3 =
	PWM_DT_SPEC_GET(DT_ALIAS(pwmled3));

extern uint16_t pwm_reg[3];
extern uint8_t coils_state;

static struct ds18b20_result ds18b20_results[MODBUS_N_THERMOMETERS];

static const struct gpio_dt_spec led_dev[] = {
	GPIO_DT_SPEC_GET(DT_ALIAS(led1), gpios),
	GPIO_DT_SPEC_GET(DT_ALIAS(led2), gpios),
};

static int coil_rd(uint16_t addr, bool *state)
{
	LOG_INF("Coil rd");
	if (addr >= ARRAY_SIZE(led_dev)) {
		return -ENOTSUP;
	}

	if (coils_state & BIT(addr)) {
		*state = true;
	} else {
		*state = false;
	}

	LOG_INF("Coil read, addr %u, %d", addr, (int)*state);

	return 0;
}

static int coil_wr(uint16_t addr, bool state)
{
	LOG_INF("Coil write");
	bool on;

	if (addr >= ARRAY_SIZE(led_dev)) {
		return -ENOTSUP;
	}


	if (state == true) {
		coils_state |= BIT(addr);
		on = true;
	} else {
		coils_state &= ~BIT(addr);
		on = false;
	}

	gpio_pin_set(led_dev[addr].port, led_dev[addr].pin, (int)on);

	LOG_INF("Coil write, addr %u, %d", addr, (int)state);

	return 0;
}

static int input_reg_rd(uint16_t addr, uint16_t *reg)
{
	struct sensor_value temp_value;
	int ret;
	//LOG_INF("Reading input reg");
	if (addr >= MODBUS_TEMP0_REG && addr < MODBUS_TEMP0_REG + MODBUS_N_THERMOMETERS*5) {
		struct ds18b20_result qresult;
		while(k_msgq_get(&ds18b20_msgq, &qresult, K_NO_WAIT) == 0) {
			LOG_INF("Got temperature result: %d", qresult.temperature_centi);
			ds18b20_results[qresult.idx].timestamp = qresult.timestamp;
			ds18b20_results[qresult.idx].temperature_centi = qresult.temperature_centi;
			memcpy(ds18b20_results[qresult.idx].id, qresult.id, sizeof(qresult.id));
		}
		int therm_idx = (addr - MODBUS_TEMP0_REG) / 5;
		int reg_offset = (addr - MODBUS_TEMP0_REG) % 5;
		if (ds18b20_results[therm_idx].timestamp + MODBUS_TEMP_MAX_AGE < k_uptime_seconds()) {
			return -ENOTSUP;
		}
		if (reg_offset < 4) {
			*reg = ds18b20_results[therm_idx].id[3-reg_offset];
		} else {
			*reg = ds18b20_results[therm_idx].temperature_centi;
		}
		return 0;
	}
	switch (addr) {
		case MODBUS_BASE_VIN_REG:
			*reg = adc_vin_v;
			break;
		case MODBUS_BASE_IIN_REG:
			*reg = adc_vin_i;
			break;
		case MODBUS_BASE_3V3_REG:
			*reg = adc_3v3_v;
			break;
		case MODBUS_BASE_TEMPINT_REG:
			*reg = adc_temp_int;
			break;
	    default:
		    return -ENOTSUP;
	}
	return 0;
}

static int holding_reg_rd(uint16_t addr, uint16_t *reg)
{
	LOG_INF("Reading holding reg");
    switch (addr)
	{
		case MODBUS_BASE_STATUS_REG:
			*reg = 0;
			break;
		case MODBUS_BASE_UPTIME_REG:
			*reg = k_uptime_seconds();
			break;
		case MODBUS_PWM0_REG:
			*reg = pwm_reg[0];
			break;
		case MODBUS_PWM1_REG:
		    *reg = pwm_reg[1];
			break;
		case MODBUS_PWM2_REG:
			*reg = pwm_reg[2];
			break;
	default:
		return -ENOTSUP;
	}
	return 0;
}

static int holding_reg_wr(uint16_t addr, uint16_t reg)
{
	LOG_INF("Writing holding reg");
    switch (addr)
	{
		case MODBUS_PWM0_REG:
			pwm_reg[0] = reg;
			set_pwm_outputs();
			break;
		case MODBUS_PWM1_REG:
			pwm_reg[1] = reg;
			set_pwm_outputs();
			break;
		case MODBUS_PWM2_REG:
			pwm_reg[2] = reg;
			set_pwm_outputs();
			break;
	default:
        LOG_INF("Unknown register %u",addr);
        return -ENOTSUP;
	}
	return 0;
}

struct modbus_user_callbacks mbs_cbs = {
	.coil_rd = coil_rd,
	.coil_wr = coil_wr,
    .input_reg_rd = input_reg_rd,
	.holding_reg_rd = holding_reg_rd,
	.holding_reg_wr = holding_reg_wr,
};
```

## src/modbus_cb.h
```c
#ifndef MODBUS_CB_H
#define MODBUS_CB_H

#include <zephyr/modbus/modbus.h>
extern struct modbus_user_callbacks mbs_cbs;

#endif
```

## src/onewire.c
```c
#include <zephyr/drivers/sensor/w1_sensor.h>
#include <zephyr/drivers/w1.h>
#include <zephyr/device.h>

#include <zephyr/logging/log.h>
LOG_MODULE_REGISTER(onewire, LOG_LEVEL_DBG);

#include "onewire.h"

const struct device const * dev_ds18b20_0 = DEVICE_DT_GET(DT_NODELABEL(ds18b20_0));
const struct device const * dev_ds18b20_1 = DEVICE_DT_GET(DT_NODELABEL(ds18b20_1));

K_MSGQ_DEFINE(ds18b20_msgq, sizeof(struct ds18b20_result), 10, 1);

struct ds18b20_sensor collected_sensors_onewire[] = {
	{
		.dev = DEVICE_DT_GET(DT_NODELABEL(ds18b20_0)),
		.valid = false
	},
	{
		.dev = DEVICE_DT_GET(DT_NODELABEL(ds18b20_1)),
		.valid = false
	}
};

const size_t num_collected_sensors_onewire = ARRAY_SIZE(collected_sensors_onewire);

static char ds18b20_names[][17] = {
	"",
	"",
};

static const struct device *ds18b20_devices[] = {
	DEVICE_DT_GET(DT_NODELABEL(ds18b20_0)),
	DEVICE_DT_GET(DT_NODELABEL(ds18b20_1)),
};

int trigger_sensors(struct ds18b20_sensor *sensors, size_t num_sensors)
{
	int total_ret = 0;
	int ret = 0;

	LOG_INF("Fetching sensors");


	for (size_t i = 0; i < num_sensors; i++) {
		ret = sensor_sample_fetch(sensors[i].dev);
		if (ret < 0) {
			LOG_ERR("Failed to fetch sample from %s", sensors[i].dev->name);
			total_ret = ret;
			sensors[i].valid = false;
		} else {
			sensors[i].valid = true;
		}
	}

	for (size_t i = 0; i < num_sensors; i++) {
		if (sensors[i].valid == false) {
			continue;
		}
		struct sensor_value temp_value;
		ret = sensor_channel_get(sensors[i].dev, SENSOR_CHAN_AMBIENT_TEMP, &temp_value);
		if (ret < 0) {
			LOG_ERR("Failed to get temperature from %s", sensors[i].dev->name);
			total_ret = ret;
			sensors[i].valid = false;
		} else {
			sensors[i].temperature_centi = sensor_value_to_centi(&temp_value);
			struct ds18b20_result result = {
				.timestamp = k_uptime_seconds(),
				.id = {0},
				.temperature_centi = sensors[i].temperature_centi,
				.idx = i
			};
			memcpy(result.id, sensors[i].id, sizeof(sensors[i].id));
			k_msgq_put(&ds18b20_msgq, &result, K_NO_WAIT);
			sensors[i].valid = true;
			LOG_INF("Sensor %s temperature: %d cC, addr: %04lx %04lx %04lx %04lx",
					sensors[i].dev	->name,
					sensors[i].temperature_centi,
					sensors[i].id[0],
					sensors[i].id[1],
					sensors[i].id[2],
					sensors[i].id[3]);
		}
	}

	return total_ret;
}

static void onewire_search_callback(struct w1_rom rom, void *user_data)
{
	LOG_INF("Found thermometer");
	if (rom.family != 0x28) {
		LOG_WRN("Found 1-wire device with unknown family %02x, skipping", rom.family);
		return;
	}

	// Find an empty slot to configure this address
	size_t i = 0;
	for (; i < ARRAY_SIZE(ds18b20_names); i++) {
		if (ds18b20_names[i][0] == '\0') {
			break;
		}
	}

	if (i == ARRAY_SIZE(ds18b20_names)) {
		LOG_ERR("Found more than %d DS18B20 sensors, skipping", ARRAY_SIZE(ds18b20_names));
		return;
	}

	// Set the name and ROM of the sensor
	snprintf(ds18b20_names[i], sizeof(ds18b20_names[i]),
			"%016llx", w1_rom_to_uint64(&rom));
	LOG_INF("Thermometer found: %s", ds18b20_names[i]);
	struct sensor_value rom_value;
	w1_rom_to_sensor_value(&rom, &rom_value);
	LOG_INF("Sensor addr: %08lx,%08lx ",rom_value.val1, rom_value.val2);
	uint64_t rom_uint64 = w1_rom_to_uint64(&rom);
	memcpy(collected_sensors_onewire[i].id, &rom_uint64, sizeof(collected_sensors_onewire[i].id));

	if (sensor_attr_set(collected_sensors_onewire[i].dev, SENSOR_CHAN_ALL,
					(enum sensor_attribute)SENSOR_ATTR_W1_ROM,
					&rom_value) < 0) {
		LOG_ERR("Failed to set ROM for sensor %s", collected_sensors_onewire[i].dev->name);
	}
}

int rescan_onewire()
{
	const struct device *onewire = DEVICE_DT_GET(DT_NODELABEL(w1));
	int ret;

	// TODO: We should be able to cache the ROMs and only rescan if we 
	// fail to read from a sensor. This is needlessly slow.

	LOG_DBG("Rescanning the 1-wire bus");

	// First, we clear the currently assigned addresses
	for (size_t i = 0; i < ARRAY_SIZE(ds18b20_names); i++) {
		struct w1_rom blank_rom = W1_ROM_INIT_ZERO;
		struct sensor_value rom_value;
		w1_rom_to_sensor_value(&blank_rom, &rom_value);

		ds18b20_names[i][0] = '\0';
		sensor_attr_set(ds18b20_devices[i], SENSOR_CHAN_ALL,
						(enum sensor_attribute)SENSOR_ATTR_W1_ROM,
						&rom_value);
	}

	// Next, we rescan the bus
	ret = w1_lock_bus(onewire);
	if (ret < 0) {
		LOG_ERR("Failed to lock the 1-wire bus");
		return ret;
	}
	ret = w1_search_rom(onewire, onewire_search_callback, NULL);
	w1_unlock_bus(onewire);

	if (ret < 0) {
		LOG_ERR("Failed to search for 1-wire devices");
		return ret;
	}

	return 0;
}
```

## src/onewire.h
```c
#ifndef ONEWIRE_H
#define ONEWIRE_H

#include <zephyr/device.h>

struct ds18b20_sensor {
	uint8_t id[8];
    const struct device *dev;
    int16_t temperature_centi;
    bool valid;
};

struct ds18b20_result {
    uint64_t timestamp;
    uint16_t id[4];
    int16_t temperature_centi;
    uint8_t idx;
};

extern struct k_msgq ds18b20_msgq;
extern struct ds18b20_sensor collected_sensors_onewire[];
extern const size_t num_collected_sensors_onewire;

int rescan_onewire();
int trigger_sensors(struct ds18b20_sensor *sensors, size_t num_sensors);

#endif // ONEWIRE_H
```

## src/pwm.c
```c
#include "pwm.h"

#include <zephyr/logging/log.h>
LOG_MODULE_REGISTER(pwm, LOG_LEVEL_DBG);

static const struct pwm_dt_spec pwm_o1 =
	PWM_DT_SPEC_GET(DT_ALIAS(pwmled1));
static const struct pwm_dt_spec pwm_o2 =
	PWM_DT_SPEC_GET(DT_ALIAS(pwmled2));
static const struct pwm_dt_spec pwm_o3 =
	PWM_DT_SPEC_GET(DT_ALIAS(pwmled3));

uint16_t pwm_reg[3] = {0, 0, 0 }; // Initial duty cycles (0-1000)

int init_pwm(void)
{
    LOG_INF("Initializing PWM devices");
    if (!pwm_is_ready_dt(&pwm_o1) ||
        !pwm_is_ready_dt(&pwm_o2) ||
        !pwm_is_ready_dt(&pwm_o3)) {
        LOG_ERR("One or more PWM devices not ready");
        return -ENODEV;
    }
    return 0;
}

int set_pwm_outputs(void)
{
    int ret;
    uint32_t raw_brightness;

    // Set PWM output 1
    raw_brightness = pwm_reg[0] * 65536 / 1000; // scale 0-1000 to 0-65536
    ret = pwm_set_pulse_dt(&pwm_o1, PWM_NSEC(raw_brightness));
    if (ret) {
        LOG_ERR("Error %d setting PWM output 1", ret);
        return ret;
    }

    // Set PWM output 2
    raw_brightness = pwm_reg[1] * 65536 / 1000; // scale 0-1000 to 0-65536
    ret = pwm_set_pulse_dt(&pwm_o2, PWM_NSEC(raw_brightness));
    if (ret) {
        LOG_ERR("Error %d setting PWM output 2", ret);
        return ret;
    }

    // Set PWM output 3
    raw_brightness = pwm_reg[2] * 65536 / 1000; // scale 0-1000 to 0-65536
    ret = pwm_set_pulse_dt(&pwm_o3, PWM_NSEC(raw_brightness));
    if (ret) {
        LOG_ERR("Error %d setting PWM output 3", ret);
        return ret;
    }

    return 0;
}
```

## src/pwm.h
```c
#ifndef PWM_H
#define PWM_H

#include <zephyr/drivers/pwm.h>

extern uint16_t pwm_reg[3]; // Duty cycles (0-1000)
#endif // PWM_H
```
