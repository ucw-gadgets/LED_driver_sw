## Kconfig
```kconfig
# Copyright (c) 2021 Nordic Semiconductor ASA
# SPDX-License-Identifier: Apache-2.0
#
# This Kconfig file is picked by the Zephyr build system because it is defined
# as the module Kconfig entry point (see zephyr/module.yml). You can browse
# module options by going to Zephyr -> Modules in Kconfig.

rsource "drivers/Kconfig"
rsource "lib/Kconfig"

config SEQUENCE_SAMPLES
	int "Number of samples to be made on the sequence for each channel."
	default 5

config SEQUENCE_RESOLUTION
	int "Set the resolution of the sequence readings."
	default 12

config SEQUENCE_OVERSAMPLING
	int "Set the oversampling of the sequence readings."
	default 0

config SEQUENCE_32BITS_REGISTERS
	bool "ADC data sequences are on 32bits"
	default n
```

## boards/jethro/led_driver_v3/Kconfig.led_driver_v3
```kconfig
# Copyright (c) 2023 Marin Jurjević <marin.jurjevic@hotmail.com>
# SPDX-License-Identifier: Apache-2.0

config BOARD_LED_DRIVER_V3
	select SOC_STM32G070XX
```

## boards/jethro/led_driver_v3/board.yml
```yaml
board:
  name: led_driver_v3
  full_name: LED driver v3
  vendor: jethro
  socs:
    - name: stm32g070xx
```
